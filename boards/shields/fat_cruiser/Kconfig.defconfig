## boards/shields/fat_cruiser/Kconfig.defconfig
```kconfig
# Copyright (c) 2025
# SPDX-License-Identifier: MIT

if SHIELD_FAT_CRUISER

config ZMK_KEYBOARD_NAME
	default "fat_cruiser"

endif
```

## boards/shields/fat_cruiser/Kconfig.shield
```kconfig
# Copyright (c) 2025
# SPDX-License-Identifier: MIT

config SHIELD_FAT_CRUISER
	def_bool $(shields_list_contains,fat_cruiser)
```
